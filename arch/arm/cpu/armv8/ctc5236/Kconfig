## arch/arm/cpu/armv8/ctc5236/Kconfig
```kconfig
config ARCH_CTC5236
	bool
	select ARMV8_SET_SMPEN
	select ARCH_EARLY_INIT_R
	select BOARD_EARLY_INIT_F

config CTC_SEC_BOOT
	bool "centec secure boot"

config CTC_SWITCH
	bool "centec switch core"
```

## board/centec/e530_24x2c/Kconfig
```kconfig
if TARGET_E530_24X2C

config SYS_BOARD
	default "e530_24x2c"

config SYS_VENDOR
	default "centec"

config SYS_SOC
	default "ctc5236"

config SYS_CONFIG_NAME
	default "e530_24x2c"

config BOARD_SPECIFIC_OPTIONS # dummy
	def_bool y

endif
```

## board/centec/e530_24x2c_p/Kconfig
```kconfig
if TARGET_E530_24X2C_P

config SYS_BOARD
	default "e530_24x2c_p"

config SYS_VENDOR
	default "centec"

config SYS_SOC
	default "ctc5236"

config SYS_CONFIG_NAME
	default "e530_24x2c_p"

config BOARD_SPECIFIC_OPTIONS # dummy
	def_bool y

endif
```

## board/centec/e530_48m4y2d/Kconfig
```kconfig
if TARGET_E530_48M4Y2D

config SYS_BOARD
	default "e530_48m4y2d"

config SYS_VENDOR
	default "centec"

config SYS_SOC
	default "ctc5236"

config SYS_CONFIG_NAME
	default "e530_48m4y2d"

config BOARD_SPECIFIC_OPTIONS # dummy
	def_bool y

endif
```

## board/centec/e530_48s4x_p/Kconfig
```kconfig
if TARGET_E530_48S4X_P

config SYS_BOARD
	default "e530_48s4x_p"

config SYS_VENDOR
	default "centec"

config SYS_SOC
	default "ctc5236"

config SYS_CONFIG_NAME
	default "e530_48s4x_p"

config BOARD_SPECIFIC_OPTIONS # dummy
	def_bool y

endif
```

## board/centec/e530_48t4x2q/Kconfig
```kconfig
if TARGET_E530_48T4X2Q

config SYS_BOARD
	default "e530_48t4x2q"

config SYS_VENDOR
	default "centec"

config SYS_SOC
	default "ctc5236"

config SYS_CONFIG_NAME
	default "e530_48t4x2q"

config BOARD_SPECIFIC_OPTIONS # dummy
	def_bool y

endif
```

## board/centec/e530_48x/Kconfig
```kconfig
if TARGET_E530_48X

config SYS_BOARD
	default "e530_48x"

config SYS_VENDOR
	default "centec"

config SYS_SOC
	default "ctc5236"

config SYS_CONFIG_NAME
	default "e530_48x"

config BOARD_SPECIFIC_OPTIONS # dummy
	def_bool y

endif
```

## board/centec/emu_ctc5236/Kconfig
```kconfig
if TARGET_EMU_CTC5236

config SYS_BOARD
	default "emu_ctc5236"

config SYS_VENDOR
	default "centec"

config SYS_SOC
	default "ctc5236"

config SYS_CONFIG_NAME
	default "emu_ctc5236"

config BOARD_SPECIFIC_OPTIONS # dummy
	def_bool y

endif
```

## board/centec/tsingma_test/Kconfig
```kconfig
if TARGET_TsingMa_Test

config SYS_BOARD
	default "tsingma_test"

config SYS_VENDOR
	default "centec"

config SYS_SOC
	default "ctc5236"

config SYS_CONFIG_NAME
	default "tsingma_test"

config BOARD_SPECIFIC_OPTIONS # dummy
	def_bool y

endif
```

## board/centec/vel_ctc5236/Kconfig
```kconfig
if TARGET_VEL_CTC5236

config SYS_BOARD
	default "vel_ctc5236"

config SYS_VENDOR
	default "centec"

config SYS_SOC
	default "ctc5236"

config SYS_CONFIG_NAME
	default "vel_ctc5236"

config BOARD_SPECIFIC_OPTIONS # dummy
	def_bool y

endif
```

## drivers/ddr/centec/Kconfig
```kconfig
config SYS_CTC_DDR
	bool "Centec DDR driver"
	depends on ARCH_CTC5236
	help
	  Enable DDR interface for the DDR devices.
```
