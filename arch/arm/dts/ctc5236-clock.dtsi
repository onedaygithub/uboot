/*
 * dts file for Centec CTC5236(TsingMa) SoC
 *
 * (C) Copyright 2004-2017 Centec Networks (suzhou) Co., LTD.
 *
 * Jay Cao <caoj@centecnetworks.com>
 *
 * This program is free software; you can redistribute it and/or
 * modify it under the terms of the GNU General Public License as
 * published by the Free Software Foundation; either version 2 of
 * the License, or (at your option) any later version.
 */

	osc: oscillator {
		compatible = "fixed-clock";
		#clock-cells = <0>;
		clock-frequency = <25000000>;
		clock-output-names = "osc";
        };

	bus_clk: clk600m {
		compatible = "fixed-clock";
		#clock-cells = <0>;
		clock-frequency = <600000000>;
		clock-output-names = "bus_clk";
        };

	uart_clk: clk25m {
		compatible = "fixed-clock";
		#clock-cells = <0>;
		clock-frequency = <12000000>;
		clock-output-names = "uart_clk";
        };

